## boards/arm/nascontrol/Kconfig.board
```kconfig
# STM32G474CET NAScontrol board configuration

# Copyright (c) 2023 Benedikt Spranger <b.spranger@linutronix.de>
# SPDX-License-Identifier: Apache-2.0

config BOARD_NASCONTROL
	bool "Eurovibes NAScontrol Board"
	depends on SOC_STM32G474XX
```

## boards/arm/nascontrol/Kconfig.defconfig
```kconfig
# STM32G474CET NAScontrol board configuration

# Copyright (c) 2023 Benedikt Spranger <b.spranger@linutronix.de>
# SPDX-License-Identifier: Apache-2.0

if BOARD_NASCONTROL

config BOARD
	default "nascontrol"

config SPI_STM32_INTERRUPT
	default y
	depends on SPI

config HEAP_MEM_POOL_SIZE
        default 4096

config USB_DEVICE_STACK
        default y

config USB_CDC_ACM
        default SERIAL

config UART_CONSOLE
        default CONSOLE

config USB_DEVICE_INITIALIZE_AT_BOOT
        default y if CONSOLE

config SHELL_BACKEND_SERIAL_CHECK_DTR
        default SHELL
        depends on UART_LINE_CTRL

config UART_LINE_CTRL
        default SHELL

config USB_DEVICE_REMOTE_WAKEUP
        default n

config USB_DEVICE_PRODUCT
        default "Eurovibes NAScontrol"

config UART_INTERRUPT_DRIVEN
        default y

config UART_LINE_CTRL
        default y

if LOG

# Logger cannot use itself to log
config USB_CDC_ACM_LOG_LEVEL
        default 0

# Set USB log level to error only
config USB_DEVICE_LOG_LEVEL
        default 1

endif # LOG

endif # BOARD_NASCONTROL
```

## boards/eurovibes/dzlicht-ng/board.yml
```yaml
board:
  name: eurovibes_stm32f103_dzlicht-ng
  full_name: STM32F103 based DZLicht-NG board
  vendor: eurovibes
  socs:
    - name: stm32f103xb
```

## boards/eurovibes/nascontrol/Kconfig.defconfig
```kconfig
# Eurovibes STM32G474CET based NAScontrol board

# Copyright (c) 2026 Benedikt Spranger
# SPDX-License-Identifier: Apache-2.0

if BOARD_EUROVIBES_STM32G474_NASCONTROL

source "boards/common/usb/Kconfig.cdc_acm_serial.defconfig"

config SPI_STM32_INTERRUPT
	default y
	depends on SPI

endif # BOARD_EUROVIBES_STM32G474_NASCONTROL
```

## boards/eurovibes/nascontrol/Kconfig.eurovibes_stm32g474_nascontrol
```kconfig
# Copyright (c) 2026 Benedikt Spranger
# SPDX-License-Identifier: Apache-2.0

config BOARD_EUROVIBES_STM32G474_NASCONTROL
	select SOC_STM32G474XX
```
