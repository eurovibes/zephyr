## boards/eurovibes/rack-ser-adapter-tester/Kconfig.eurovibes_stm32f103_rack-ser-adapter-tester
```kconfig
# Copyright (c) 2026 Benedikt Spranger
# SPDX-License-Identifier: Apache-2.0

config BOARD_EUROVIBES_STM32F103_RACK_SER_ADAPTER_TESTER
	select SOC_STM32F103XB
```

## boards/eurovibes/rack-ser-adapter-tester/board.yml
```yaml
board:
  name: eurovibes_stm32f103_rack-ser-adapter-tester
  full_name: STM32F103 based serial adapter tester board
  vendor: eurovibes
  socs:
    - name: stm32f103xb
```
